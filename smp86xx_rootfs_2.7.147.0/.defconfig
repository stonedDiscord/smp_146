## smp86xx_rootfs_2.7.147.0/toolchain/Config.in
```kconfig
menu "Toolchain Options"

comment "Common Toolchain Options"

config BR2_TARGET_OPTIMIZATION
	string "Target Optimizations"
	default "-Os -pipe"
	help
	  Optimizations to use when building for the target host.

endmenu

source "toolchain/kernel-headers/Config.in"
```

## smp86xx_rootfs_2.7.147.0/toolchain/gdb/Config.in
```kconfig
config BR2_PACKAGE_GDB_SERVER
	bool "Build gdb server for the Target"
	default n
	help
	    Build the gdbserver stub to run on the target.
	    A full gdb is needed to debug the progam.

config BR2_GDB_VERSION_6_3
	bool 
#	"gdb 6.3"
	default y

config BR2_GDB_VERSION
	string
	default "6.3"      if BR2_GDB_VERSION_6_3
```

## smp86xx_toolchain_2.7.147.0/toolchain/binutils/Config.in
```kconfig
# Choose binutils version.

comment "Binutils Options"

config BR2_BINUTILS_VERSION_2_15_91_0_2
	bool
#	"binutils 2.15.91.0.2"
	default y

config BR2_BINUTILS_VERSION
	string
	default "2.15.91.0.2"     if BR2_BINUTILS_VERSION_2_15_91_0_2
```

## smp86xx_toolchain_2.7.147.0/toolchain/ccache/Config.in
```kconfig
#

comment "Ccache Options"

config BR2_CCACHE
	bool
	default y
	help
	    Enable ccache support?
```

## smp86xx_toolchain_2.7.147.0/toolchain/gcc/Config.in
```kconfig
# Choose gcc version.
# WARNING -- 2.95 currently only builds for i386, arm, mips*, and powerpc.
# WARNING -- 2.95 does not currently build natively for the target.

comment "Gcc Options"

config BR2_GCC_VERSION_3_4_2
	bool
#	"gcc 3.4.2"
	default y

config BR2_GCC_VERSION
	string
	default "3.4.2"     if BR2_GCC_VERSION_3_4_2


config BR2_GCC_USE_SJLJ_EXCEPTIONS
	string
	default "--enable-sjlj-exceptions"
	help
	    Currently the unwind stuff seems to work for staticly linked apps
	    but not dynamic.  So use setjmp/longjmp exceptions by default.

config BR2_EXTRA_GCC_CONFIG_OPTIONS
	string "Additional gcc options"
	default ""
	help
	    Any additional gcc options you may want to include....

config BR2_INSTALL_LIBSTDCPP
	bool
	default y
	help
	    Build/install c++ compiler and libstdc++?

config BR2_INSTALL_LIBGCJ
	bool
	default n
	depends on BR2_INSTALL_LIBSTDCPP
	help
	    Build/install java compiler and libgcj?

config BR2_INSTALL_OBJC
	bool
	default n
	help
	    Build/install Objective-C compiler and runtime?
```

## smp86xx_toolchain_2.7.147.0/toolchain/gdb/Config.in
```kconfig
comment "Gdb Options"

config BR2_PACKAGE_GDB_CLIENT
	bool
	default y
	help
	    Build gdb to run on the host to debug programs running on the target.

config BR2_GDB_VERSION_6_3
	bool
#	"gdb 6.3"
	default y

config BR2_GDB_VERSION
	string
	default "6.3"      if BR2_GDB_VERSION_6_3
```

## smp86xx_toolchain_2.7.147.0/toolchain/kernel-headers/Config.in
```kconfig
# Choose the kernel headers to use for kernel-headers target. This is
# ignored if you are building your own kernel or using the system kernel.
#

comment "Kernel Header Options"

config BR2_KERNEL_HEADERS_2_4_29
	bool
#	"Linux 2.4.29 kernel headers"
	default y

config BR2_DEFAULT_KERNEL_HEADERS
	string
	default "2.4.29"	if BR2_KERNEL_HEADERS_2_4_29
```

## smp86xx_toolchain_2.7.147.0/toolchain/uClibc/Config.in
```kconfig
# Choose uClibc options
#

comment "uClibc Options"

config BR2_UCLIBC_VERSION_SNAPSHOT
	bool
	default n
	help
	    Would you like to use the latest daily snapshot?

config BR2_USE_UCLIBC_SNAPSHOT
	string
	default "snapshot"
	depends on BR2_UCLIBC_VERSION_SNAPSHOT

config BR2_ENABLE_LOCALE
	bool
	default n
	help
	    Enable locale/gettext/i18n support?
```
